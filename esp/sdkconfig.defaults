## esp/sdkconfig.defaults
```kconfig
# Partition Table
#CONFIG_PARTITION_TABLE_SINGLE_APP=y
#CONFIG_PARTITION_TABLE_CUSTOM=y
#CONFIG_PARTITION_TABLE_CUSTOM_FILENAME="/project/pio/partitions.csv"
#CONFIG_PARTITION_TABLE_FILENAME="/project/pio/partitions.csv"
#CONFIG_PARTITION_TABLE_OFFSET=0x8000
#CONFIG_PARTITION_TABLE_MD5=y
# end of Partition Table

#CONFIG_ESP_TLS_INSECURE=y
#CONFIG_ESP_TLS_SKIP_SERVER_CERT_VERIFY=y

#CONFIG_ESP32_ECO3_CACHE_LOCK_FIX=y

#CONFIG_ESP32_SPIRAM_SUPPORT=y
#CONFIG_SPIRAM_TYPE_AUTO=y
#CONFIG_SPIRAM_SIZE=-1
#CONFIG_SPIRAM_SPEED_40M=y
#CONFIG_SPIRAM=y
#CONFIG_SPIRAM_BOOT_INIT=y
#CONFIG_SPIRAM_USE_MALLOC=y
#CONFIG_SPIRAM_MEMTEST=y
#CONFIG_SPIRAM_MALLOC_ALWAYSINTERNAL=16384
#CONFIG_SPIRAM_MALLOC_RESERVE_INTERNAL=32768
#CONFIG_SPIRAM_CACHE_WORKAROUND=y

CONFIG_ESP_MAIN_TASK_STACK_SIZE=65536
CONFIG_ESP_TASK_WDT_TIMEOUT_S=30

CONFIG_ESP_GDBSTUB_ENABLED=y
CONFIG_ESP_GDBSTUB_SUPPORT_TASKS=y
CONFIG_ESP_GDBSTUB_MAX_TASKS=32

CONFIG_ESP_SYSTEM_PANIC_GDBSTUB=y

#
# Wi-Fi
#
CONFIG_ESP32_WIFI_STATIC_RX_BUFFER_NUM=10
CONFIG_ESP32_WIFI_DYNAMIC_RX_BUFFER_NUM=32
CONFIG_ESP32_WIFI_STATIC_TX_BUFFER=y
CONFIG_ESP32_WIFI_TX_BUFFER_TYPE=0
CONFIG_ESP32_WIFI_STATIC_TX_BUFFER_NUM=16
CONFIG_ESP32_WIFI_CACHE_TX_BUFFER_NUM=32

CONFIG_EPD_DISPLAY_TYPE_ED047TC1=y
CONFIG_EPD_BOARD_REVISION_LILYGO_T5_47=y

CONFIG_LOG_BOOTLOADER_LEVEL_WARN=y
CONFIG_LOG_BOOTLOADER_LEVEL=2

CONFIG_SPIRAM_SUPPORT=y
CONFIG_MAIN_TASK_STACK_SIZE=65536

CONFIG_TASK_WDT_TIMEOUT_S=30

# CONFIG_TASK_WDT_CHECK_IDLE_TASK_CPU0 is not set
# CONFIG_TASK_WDT_CHECK_IDLE_TASK_CPU1 is not set
CONFIG_GDBSTUB_SUPPORT_TASKS=y
CONFIG_GDBSTUB_MAX_TASKS=32
CONFIG_ESP32S2_PANIC_GDBSTUB=y
```
